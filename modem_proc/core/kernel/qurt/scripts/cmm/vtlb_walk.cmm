;==============================================================================
; @file vtlb_walk.cmm
; @detail Script to lookup an entry covering virtual address by walking VTLB
;         lookup tables
; @usage do vtlb_walk.cmm <virtual-address>
; @todo ASID is assumed to be zero. Fix this!
; Copyright (c) 2018 by Qualcomm Technologies, Inc.  All Rights Reserved.
;==============================================================================
area.create vtlb_walk 160. 215.
area.select vtlb_walk
area.view vtlb_walk

;==============================================================================
; Argument
;==============================================================================
entry &vaddr

;==============================================================================
; Constants
;-=============================================================================
global &ASID
&ASID=0.

global &VTLB_TREE_COUNT
&VTLB_TREE_COUNT=8192.

global &VTLB_TREE_SIZE
&VTLB_TREE_SIZE=&VTLB_TREE_COUNT*2.

global &VTLB_MAX_ENTRIES
&VTLB_MAX_ENTRIES=2048.

;==============================================================================
; Locals
;-=============================================================================
local &expected_vpage
local &actual_vpage
local &L1_idx
local &L2_idx
local &L3_idx
local &L4_idx
local &L5_idx
local &asid
local &entry_idx
local &entry
var.newlocal unsigned short * \t32_qurtk_vtlb_tree
var.newlocal unsigned long long * \t32_qurtk_vtlb_entries

;==============================================================================
; main()
;-=============================================================================
if ("&vaddr"=="")
(
    print %error "error: virtual address as argument required"
    enddo
)

&asid=&ASID

var.assign \t32_qurtk_vtlb_tree=&QURTK_vtlb_tree
var.assign \t32_qurtk_vtlb_entries=&QURTK_vtlb_entries

; Extract 20b VPAGE
&expected_vpage=&vaddr>>12.
&vpage_8=&expected_vpage>>12.
&vpage_4a=(&expected_vpage>>8.)&0xF
&vpage_4b=(&expected_vpage>>4.)&0xF
&vpage_4c=&expected_vpage&0xF

print "vaddr=" format.hex(8,&vaddr)

&L1_idx=var.value(\t32_qurtk_vtlb_tree[&asid])
print "L1_idx=" format.hex(4,&L1_idx)

&L2_idx=var.value(\t32_qurtk_vtlb_tree[(&L1_idx*4.)+&vpage_8])
print "L2_idx=" format.hex(4,&L2_idx)
if ((&L2_idx&1)==1)
(
    &entry_idx=&L2_idx
    goto entry_found
)

&L3_idx=var.value(\t32_qurtk_vtlb_tree[(&L2_idx*4.)+&vpage_4a])
;&L3_idx=0x790
print "L3_idx=" format.hex(4,&L3_idx)
if ((&L3_idx&1)==1)
(
    &entry_idx=&L3_idx
    goto entry_found
)

&L4_idx=var.value(\t32_qurtk_vtlb_tree[(&L3_idx*4.)+&vpage_4b])
print "L4_idx=" format.hex(4,&L4_idx)
if ((&L4_idx&1)==1)
(
    &entry_idx=&L4_idx
    goto entry_found
)

&L5_idx=var.value(\t32_qurtk_vtlb_tree[(&L4_idx*4.)+&vpage_4c])
print "L5_idx=" format.hex(4,&L5_idx)
if ((&L5_idx&1)==1)
(
    &entry_idx=&L5_idx
    goto entry_found
)

entry_found:
; entry_idx[0] is expected to be 1 for leaf entry. To convert this into
; an index into the entries, we need to shift it out
&entry=var.value(\t32_qurtk_vtlb_entries[&entry_idx>>1])


&actual_vpage=(&entry>>32.)&0xFFFFF
if (&actual_vpage==&expected_vpage)
(
    print format.hex(8,&vaddr) " is covered by VTLB[" format.hex(4,&entry_idx>>1) "] with value " format.hex(16,&entry)
)
else
(
    print %error "Expected VPAGE " format.hex(5,&expected_vpage) " != actual VPAGE " format.hex(5,&actual_vpage)
    print %error format.hex(8,&vaddr) " is unreachable by VTLB walk!"
)
enddo

