//============================================================================
//  Name:                                                                     
//    std_cti_mpss_wrapper.cmm 
//
//  Description:                                                              
//    Wakes processor by sending CTI pulse
//                                                                            
// Copyright (c) 2012 - 2014 by Qualcomm Technologies, Incorporated.  All Rights Reserved.        
//
//
//
//
//                      EDIT HISTORY FOR FILE
//  This section contains comments describing changes made to the module.
//  Notice that changes are listed in reverse chronological order.
//
// when       who     		what, where, why
// --------   ---     		---------------------------------------------------------
// 04/07/2015 JBILLING      Minor abstractions
// 05/22/2014 jbilling	    Created as wrapper for std_cti_mpss
// 06/12/2014 jbilling      Minor bug fixes found during 8994 bringup
// 05/22/2014 jbilling	    Added further functionality for new s/w driver. renamed
// 05/09/2014 jbilling      Initial creation
//
//  Usage:
//      do std_cti_mpss_wrapper <Subroutine>
//
//  Dependencies
//  This script is expected to be run from within context of metabuild scripts.
//
//####################Declarations#######################
LOCAL &ArgumentLine
LOCAL &UTILITY &OPTION &IARG0 &IARG1 &IARG2 &IARG3 &IARG4 &IARG5 &IARG6 &IARG7 &IARG8 &IARG9 &IARG10 &IARG11
//###################Arguments passed #####################
ENTRY %LINE &ArgumentLine
ENTRY &UTILITY &OPTION &IARG0 &IARG1 &IARG2 &IARG3 &IARG4 &IARG5 &IARG6 &IARG7 &IARG8 &IARG9 &IARG10 &IARG11



//##################Get configurations for this target###############//
LOCAL &targetprocessor
&targetprocessor="mpss"


        
//#####################Select Subroutine###################

	IF (FILE.EXIST("&METASCRIPTSDIR/&targetprocessor/std_cti_&targetprocessor.cmm"))
	(
		DO std_utils EXECUTESCRIPT EXIT &METASCRIPTSDIR/&targetprocessor/std_cti_&targetprocessor &ArgumentLine
		GOTO EXIT
  	)
	ELSE
	(
		PRINT %ERROR "ERROR! Could not find std_cti_&targetprocessor in metabuild directory"
		GOTO FATALEXIT
	)

GOTO EXIT    
        
EXIT:
    ENDDO &SUCCESS
    
FATALEXIT:
    END
   
